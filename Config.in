## Config.in
```kconfig
# Add project-specific packages for Buildroot here
#
# If these are non-proprietary, please consider contributing them back to
# Nerves or Buildroot.

source "$NERVES_DEFCONFIG_DIR/package/arm-linux-gnueabi/Config.in.host"
source "$NERVES_DEFCONFIG_DIR/package/shofel2/Config.in.host"
source "$NERVES_DEFCONFIG_DIR/package/switch-coreboot/Config.in.host"
```

## nerves_defconfig
```kconfig
BR2_aarch64=y
BR2_ARM_FPU_VFPV3D16=y
BR2_GLOBAL_PATCH_DIR="${BR2_EXTERNAL_NERVES_PATH}/patches"
BR2_TOOLCHAIN_EXTERNAL=y
BR2_TOOLCHAIN_EXTERNAL_CUSTOM=y
BR2_TOOLCHAIN_EXTERNAL_DOWNLOAD=y
BR2_TOOLCHAIN_EXTERNAL_URL="https://releases.linaro.org/components/toolchain/binaries/latest-6/aarch64-linux-gnu/gcc-linaro-6.4.1-2017.11-x86_64_aarch64-linux-gnu.tar.xz"
BR2_TOOLCHAIN_EXTERNAL_CUSTOM_PREFIX="aarch64-linux-gnu"
BR2_TOOLCHAIN_EXTERNAL_GCC_6=y
BR2_TOOLCHAIN_EXTERNAL_HEADERS_4_6=y
BR2_TOOLCHAIN_EXTERNAL_CUSTOM_GLIBC=y
BR2_TOOLCHAIN_EXTERNAL_CXX=y
BR2_ROOTFS_SKELETON_CUSTOM=y
BR2_ROOTFS_SKELETON_CUSTOM_PATH="${BR2_EXTERNAL_NERVES_PATH}/board/nerves-common/skeleton"
BR2_INIT_NONE=y
BR2_ENABLE_LOCALE_WHITELIST="locale-archive"
BR2_GENERATE_LOCALE="en_US.UTF-8"
BR2_ROOTFS_OVERLAY="${BR2_EXTERNAL_NERVES_PATH}/board/nerves-common/rootfs_overlay ${NERVES_DEFCONFIG_DIR}/rootfs_overlay"
BR2_ROOTFS_POST_BUILD_SCRIPT="${NERVES_DEFCONFIG_DIR}/post-build.sh ${BR2_EXTERNAL_NERVES_PATH}/board/nerves-common/post-build.sh"
BR2_ROOTFS_POST_IMAGE_SCRIPT="${NERVES_DEFCONFIG_DIR}/post-createfs.sh"
BR2_LINUX_KERNEL=y
BR2_LINUX_KERNEL_CUSTOM_GIT=y
BR2_LINUX_KERNEL_CUSTOM_REPO_URL="git@github.com:fail0verflow/switch-linux.git"
BR2_LINUX_KERNEL_CUSTOM_REPO_VERSION="01b404c2112028a48ccf533b84218689032054c3"
BR2_LINUX_KERNEL_USE_CUSTOM_CONFIG=y
BR2_LINUX_KERNEL_CUSTOM_CONFIG_FILE="${NERVES_DEFCONFIG_DIR}/linux-4.16.defconfig"
BR2_LINUX_KERNEL_DTS_SUPPORT=y
BR2_LINUX_KERNEL_INTREE_DTS_NAME="nvidia/tegra210-nintendo-switch"
BR2_LINUX_KERNEL_EXT_KERNEL_WIRELESS_REGDB=y
BR2_PACKAGE_BUSYBOX_CONFIG="${BR2_EXTERNAL_NERVES_PATH}/board/nerves-common/busybox-1.22.config"
BR2_PACKAGE_E2FSPROGS=y
# BR2_PACKAGE_E2FSPROGS_FSCK is not set
BR2_PACKAGE_LIBMNL=y
BR2_PACKAGE_WPA_SUPPLICANT=y
BR2_PACKAGE_WPA_SUPPLICANT_DEBUG_SYSLOG=y
# BR2_TARGET_ROOTFS_TAR is not set
BR2_TARGET_UBOOT=y
BR2_TARGET_UBOOT_BUILD_SYSTEM_KCONFIG=y
BR2_TARGET_UBOOT_CUSTOM_GIT=y
BR2_TARGET_UBOOT_CUSTOM_REPO_URL="git@github.com:fail0verflow/switch-u-boot.git"
BR2_TARGET_UBOOT_CUSTOM_REPO_VERSION="a2d885d448eacb72085f262f9b28951384a8e678"
BR2_TARGET_UBOOT_BOARD_DEFCONFIG="nintendo-switch"
BR2_TARGET_UBOOT_NEEDS_DTC=y
# BR2_TARGET_UBOOT_FORMAT_BIN is not set
BR2_TARGET_UBOOT_FORMAT_ELF=y
BR2_PACKAGE_HOST_UBOOT_TOOLS=y
BR2_NERVES_SYSTEM_NAME="nerves_system_ns"
BR2_NERVES_ADDITIONAL_IMAGE_FILES="${NERVES_DEFCONFIG_DIR}/fwup.conf"
BR2_PACKAGE_NBTTY=y
BR2_PACKAGE_NERVES_CONFIG=y
BR2_PACKAGE_HOST_ARM_LINUX_GNUEABI=y
BR2_PACKAGE_HOST_SHOFEL2=y
BR2_PACKAGE_HOST_SWITCHCOREBOOT=y
```

## package/arm-linux-gnueabi/Config.in.host
```kconfig
config BR2_PACKAGE_HOST_ARM_LINUX_GNUEABI
        bool "arm-linux-gnueabi"
        help
          too many toolchains!
```

## package/shofel2/Config.in.host
```kconfig
config BR2_PACKAGE_HOST_SHOFEL2
        bool "shofel2"
        help
          A misleadingly-named Tegra X1 Boot ROM exploit and Nintendo Switch Linux loader.
```

## package/switch-coreboot/Config.in.host
```kconfig
config BR2_PACKAGE_HOST_SWITCHCOREBOOT
        bool "switch-coreboot"
        help
          A misleadingly-named Tegra X1 Boot ROM exploit and Nintendo Switch Linux loader.
```
